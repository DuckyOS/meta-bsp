## conf/layer.conf
```bitbake
BBPATH ?= ""
# We have a conf and classes directory, add to BBPATH
BBPATH .= ":${LAYERDIR}"
# We have recipe directories, add to BBFILES
BBFILES += "${LAYERDIR}/recipes-*/*/*.bb ${LAYERDIR}/recipes-*/*/*.bbappend"

BBFILE_COLLECTIONS += "meta-bsp"
BBFILE_PATTERN_meta-bsp := "^${LAYERDIR}/"
BBFILE_PRIORITY_meta-bsp = "20"

LAYERSERIES_COMPAT_meta-bsp = "kirkstone"

LAYERDEPENDS_meta-bsp = "\
  android-layer \
"
```
